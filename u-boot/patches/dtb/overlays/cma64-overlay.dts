/*
 * cma64.dts
 */

/dts-v1/;
/plugin/;

/*
 * "cma" overlay uses  #size-cells = <1>. Raspberry Pi 5 uses #size-cells = <2>
 */

/ {
	compatible = "brcm,bcm2712";

	fragment@0 {
		target = <&cma>;
		frag0: __overlay__ {
			/*
			 * The default size when using this overlay is 256 MB
			 * and should be kept as is for backwards
			 * compatibility.
			 */
			size = <0x0 0x10000000>;
		};
	};

	__overrides__ {
		cma-512 = <&frag0>,"size:4=0x20000000";
		cma-448 = <&frag0>,"size:4=0x1c000000";
		cma-384 = <&frag0>,"size:4=0x18000000";
		cma-320 = <&frag0>,"size:4=0x14000000";
		cma-256 = <&frag0>,"size:4=0x10000000";
		cma-192 = <&frag0>,"size:4=0x0C000000";
		cma-128 = <&frag0>,"size:4=0x08000000";
		cma-96  = <&frag0>,"size:4=0x06000000";
		cma-64  = <&frag0>,"size:4=0x04000000";
		cma-size = <&frag0>,"size:4"; /* in bytes, 4MB aligned */
		cma-default = <0>,"-0";
	};
};
